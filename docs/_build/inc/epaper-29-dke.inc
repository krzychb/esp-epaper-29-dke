.. File automatically generated by 'gen-dxd.py'

Header File
^^^^^^^^^^^

* :component_file:`epaper-29-dke/epaper-29-dke.h`

Functions
^^^^^^^^^

.. doxygenfunction:: iot_epaper_create
.. doxygenfunction:: iot_epaper_delete
.. doxygenfunction:: iot_epaper_clean_paint
.. doxygenfunction:: iot_epaper_get_width
.. doxygenfunction:: iot_epaper_set_width
.. doxygenfunction:: iot_epaper_get_height
.. doxygenfunction:: iot_epaper_set_height
.. doxygenfunction:: iot_epaper_get_rotate
.. doxygenfunction:: iot_epaper_set_rotate
.. doxygenfunction:: iot_epaper_get_image
.. doxygenfunction:: iot_epaper_draw_string
.. doxygenfunction:: iot_epaper_draw_pixel
.. doxygenfunction:: iot_epaper_draw_char
.. doxygenfunction:: iot_epaper_draw_line
.. doxygenfunction:: iot_epaper_draw_horizontal_line
.. doxygenfunction:: iot_epaper_draw_vertical_line
.. doxygenfunction:: iot_epaper_draw_rectangle
.. doxygenfunction:: iot_epaper_draw_filled_rectangle
.. doxygenfunction:: iot_epaper_draw_circle
.. doxygenfunction:: iot_epaper_draw_filled_circle
.. doxygenfunction:: iot_epaper_wait_idle
.. doxygenfunction:: iot_epaper_reset
.. doxygenfunction:: iot_epaper_display_frame
.. doxygenfunction:: iot_epaper_sleep

Structures
^^^^^^^^^^

.. doxygenstruct:: epaper_font_t
    :members:

.. doxygenstruct:: epaper_paint_t
    :members:

.. doxygenstruct:: epaper_conf_t
    :members:


Macros
^^^^^^

.. doxygendefine:: COLORED
.. doxygendefine:: UNCOLORED
.. doxygendefine:: EPD_WIDTH
.. doxygendefine:: EPD_HEIGHT
.. doxygendefine:: E_PAPER_DRIVER_OUTPUT_CONTROL
.. doxygendefine:: E_PAPER_DEEP_SLEEP_MODE
.. doxygendefine:: E_PAPER_SW_RESET
.. doxygendefine:: E_PAPER_MASTER_ACTIVATION
.. doxygendefine:: E_PAPER_DISPLAY_UPDATE_CONTROL_2
.. doxygendefine:: E_PAPER_WRITE_RAM
.. doxygendefine:: E_PAPER_WRITE_VCOM_REGISTER
.. doxygendefine:: E_PAPER_WRITE_LUT_REGISTER
.. doxygendefine:: E_PAPER_SET_RAM_X_ADDRESS_START_END_POSITION
.. doxygendefine:: E_PAPER_SET_RAM_Y_ADDRESS_START_END_POSITION
.. doxygendefine:: E_PAPER_SET_RAM_X_ADDRESS_COUNTER
.. doxygendefine:: E_PAPER_SET_RAM_Y_ADDRESS_COUNTER

Type Definitions
^^^^^^^^^^^^^^^^

.. doxygentypedef:: epaper_handle_t

Enumerations
^^^^^^^^^^^^

.. doxygenenum:: epaper_rotate_t

